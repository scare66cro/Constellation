## qemu-constellation/hw/arm/am243x/Kconfig
```kconfig
config CONSTELLATION_NOVA
    bool
    default y
    depends on TCG && ARM
    select UNIMP
    select SERIAL

config CONSTELLATION_ORBIT
    bool
    default y
    depends on TCG && ARM
    select UNIMP
    select SERIAL
```
